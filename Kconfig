## Kconfig
```kconfig
menuconfig NFC_QTI_I2C
  tristate "QTI NCI based NFC I2C Slave Driver for SNxxx"
  depends on I2C
  help
    This enables the NFC driver for SNxxx based devices.
    This is for I2C connected version. NCI protocol logic
    resides in the usermode and it has no other NFC dependencies.

    If unsure, say N.
```
